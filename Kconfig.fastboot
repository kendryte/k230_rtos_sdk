## Kconfig.fastboot
```kconfig
menuconfig FAST_BOOT_CONFIGURATION
    bool "Fast Boot Configuration"
    default y

    if FAST_BOOT_CONFIGURATION

        config FAST_BOOT_FILE_PATH
        string "Fast boot file path"
        default "${SDK_BUILD_IMAGES_DIR}/sdcard/micropython"
        help
            Path to the file to be packaged as rtapp.elf.gz, you can use absolute path
            Or you can use ${SDK_*} variables which will be expanded at build time.
            Example: ${SDK_BUILD_IMAGES_DIR}/sdcard/micropython

        config FAST_BOOT_DELETE_ORIGIIN_FILE
            bool "Delete Origin Fastboot App"
            default y
            help
                Delete the original Fast boot file, so it will not exists in filesystem.

        config FAST_BOOT_QUIET
            bool "Reduce boot banners and DDR training progress logs"
            default y
            help
                Suppress DDR initialization banners and training progress
                when building U-Boot from source, and the OpenSBI banner
                when building OpenSBI from source. Prebuilt firmware keeps
                its compiled logging behavior. RT-Smart prints only
                one line with SDK and nncase versions instead of the full banner.
                DDR errors and the MicroPython entry timestamp remain visible.
                Disable to see DDR progress and the full version banner.

    endif
```

## boards/k230_canmv_seekfree/Kconfig
```kconfig
if BOARD_K230_CANMV_SEEKFREE
    config BOARD_NOT_SUPPORT_HW_RTC
        def_bool y
endif
```

## configs/k230_rtos_dongshanpi_v3_defconfig
```kconfig
CONFIG_BOARD_CONFIG_NAME="k230_rtos_dongshanpi_v3_defconfig"
# CONFIG_BOARD_K230_CANMV_DONGSHANPI is not set
CONFIG_BOARD_NAME="RtSmart-K230_DONGSHANPI_V3"
CONFIG_BOARD_GEN_IMAGE_CFG_FILE="genimage-sdcard-rtos.cfg"
CONFIG_RTT_AUTO_EXEC_CMD=""
# CONFIG_FAST_BOOT_CONFIGURATION is not set
CONFIG_RTSMART_ENABLE_BUILD_EXAMPLES=y
CONFIG_RTSMART_ENABLE_BUILD_INTEGRATED_EXAMPLES=y
# CONFIG_UBOOT_USE_PREBUILT is not set
CONFIG_ENABLE_UVC_CAMERA=y
CONFIG_MPP_DEFAULT_SENSOR_CSI_0=y
CONFIG_MPP_CSI0_LINK_MODE_4LANE=y
CONFIG_MPP_ENABLE_CSI_DEV_0=y
CONFIG_MPP_CSI_DEV0_POWER=-1
CONFIG_MPP_CSI_DEV0_RESET=11
CONFIG_MPP_CSI_DEV0_MCLK_1=y
# CONFIG_MPP_ENABLE_CSI_DEV_1 is not set
CONFIG_MPP_ENABLE_CSI_DEV_2=y
CONFIG_MPP_CSI_DEV2_RESET=21
CONFIG_MPP_CSI_DEV2_I2C_DEV="i2c4"
CONFIG_MPP_CSI_DEV2_MCLK_1=y
CONFIG_MPP_ENABLE_SENSOR_GC2093=y
CONFIG_MPP_SENSOR_GC2093_ON_CSI0_USE_CHIP_CLK=y
CONFIG_MPP_SENSOR_GC2093_ON_CSI2_USE_CHIP_CLK=y
CONFIG_MPP_ENABLE_SENSOR_OV13850=y
CONFIG_MPP_SENSOR_OV13850_ENABLE_4LANE_CONFIGURE=y
# CONFIG_MPP_SENSOR_OV13850_ON_CSI0_USE_CHIP_CLK is not set
CONFIG_MPP_ENABLE_SENSOR_OV5647=y
CONFIG_MPP_SENSOR_OV5647_ON_CSI2_USE_CHIP_CLK=y
# CONFIG_MPP_ENABLE_DSI_HDMI is not set
CONFIG_MPP_ENABLE_DSI_LCD=y
CONFIG_MPP_DSI_LCD_RESET_PIN=22
# CONFIG_MPP_DSI_ENABLE_HDMI_LT9611 is not set
CONFIG_MPP_DSI_ENABLE_LCD_ST7701=y
# CONFIG_MPP_DSI_ENABLE_LCD_ILI9806 is not set
CONFIG_OPENSBI_USE_PREBUILT_FW_JUMP=y
# CONFIG_SDK_ENABLE_CANMV is not set
CONFIG_BOARD_K230_CANMV_DONGSHANPI_V3=y
CONFIG_AUTO_DETECT_DDR_SIZE=y
CONFIG_MPP_DSI_LCD_BACKLIGHT_PIN=25
CONFIG_ENABLE_NETWORK_RT_WLAN=y
# CONFIG_RTSMART_HAL_ENABLE_VG_LITE is not set
# CONFIG_RTSMART_3RD_PARTY_LVGL_USE_VGLITE is not set
```

## configs/k230_rtos_evb_spinor_defconfig
```kconfig
CONFIG_BOARD_CONFIG_NAME="k230_rtos_evb_spinor_defconfig"
CONFIG_BOARD_K230_EVB=y
CONFIG_BOARD_NAME="K230_EVB_SPINOR"
CONFIG_BOARD_GEN_IMAGE_CFG_FILE="genimage-spinor.cfg"
CONFIG_AUTO_DETECT_DDR_SIZE=y
# CONFIG_AUTO_DDR_SIZE_1024 is not set
# CONFIG_AUTO_DDR_SIZE_2048 is not set
CONFIG_UBOOT_CONFIG_FILE="k230_evb_spinor"
CONFIG_RTSMART_CONFIG_FILE="k230_evb_spinor"
# CONFIG_RT_AUTO_RESIZE_PARTITION is not set
CONFIG_RTSMART_3RD_PARTY_ENABLE_LIBPEER=y
# CONFIG_MPP_ISP_CONFIG_INSTALL_JSON_XML is not set
CONFIG_MPP_ENABLE_CSI_DEV_0=y
CONFIG_MPP_CSI_DEV0_RESET=46
CONFIG_MPP_ENABLE_SENSOR_IMX335=y
CONFIG_MPP_ENABLE_DSI_LCD=y
CONFIG_MPP_DSI_LCD_RESET_PIN=9
CONFIG_MPP_DSI_LCD_BACKLIGHT_PIN=31
CONFIG_MPP_DSI_ENABLE_LCD_HX8399=y
CONFIG_OPENSBI_USE_PREBUILT_FW_JUMP=y
```

## configs/k230_rtos_yahboom_defconfig
```kconfig
CONFIG_BOARD_CONFIG_NAME="k230_rtos_yahboom_defconfig"
CONFIG_BOARD_NAME="RtSmart-K230_YAHBOOM"
CONFIG_BOARD_GEN_IMAGE_CFG_FILE="genimage-sdcard-rtos.cfg"
CONFIG_RTT_AUTO_EXEC_CMD="@preload -K /sdcard/app/examples/integrated_poc/smart_ipc/face_detection_320.kmodel -C 1"
CONFIG_FAST_BOOT_FILE_PATH="${SDK_BUILD_IMAGES_DIR}/sdcard/app/examples/integrated_poc/smart_ipc/smart_ipc.elf"
CONFIG_RTSMART_ENABLE_BUILD_EXAMPLES=y
CONFIG_RTSMART_ENABLE_BUILD_INTEGRATED_EXAMPLES=y
CONFIG_BOARD_K230_CANMV_YAHBOOM=y
CONFIG_ENABLE_UVC_CAMERA=y
CONFIG_MPP_DEFAULT_SENSOR_CSI_2=y
CONFIG_MPP_ENABLE_SENSOR_AF=y
CONFIG_MPP_ENABLE_SENSOR_AF_DRV_DW9714P=y
CONFIG_MPP_ENABLE_CSI_DEV_2=y
CONFIG_MPP_CSI_DEV2_RESET=62
CONFIG_MPP_CSI_DEV2_I2C_DEV="i2c4"
CONFIG_MPP_CSI_DEV2_MCLK_3=y
CONFIG_MPP_ENABLE_SENSOR_GC2093=y
CONFIG_MPP_SENSOR_GC2093_ON_CSI2_USE_CHIP_CLK=y
CONFIG_MPP_ENABLE_DSI_LCD=y
CONFIG_MPP_DSI_LCD_RESET_PIN=22
CONFIG_MPP_DSI_ENABLE_LCD_ST7701=y
CONFIG_OPENSBI_USE_PREBUILT_FW_JUMP=y
```

## configs/k230d_rtos_atk_dnk230d_defconfig
```kconfig
CONFIG_BOARD_CONFIG_NAME="k230d_rtos_atk_dnk230d_defconfig"
CONFIG_BOARD_NAME="RtSmart-K230D_ATK_DNK230D"
CONFIG_BOARD_GEN_IMAGE_CFG_FILE="genimage-sdcard-rtos.cfg"
CONFIG_RTT_AUTO_EXEC_CMD="@preload -K /sdcard/app/examples/integrated_poc/smart_ipc/face_detection_320.kmodel -C 1"
CONFIG_FAST_BOOT_FILE_PATH="${SDK_BUILD_IMAGES_DIR}/sdcard/app/examples/integrated_poc/smart_ipc/smart_ipc.elf"
CONFIG_RTSMART_ENABLE_BUILD_EXAMPLES=y
CONFIG_RTSMART_ENABLE_BUILD_INTEGRATED_EXAMPLES=y
CONFIG_BOARD_K230D_CANMV_ATK_DNK230D=y
CONFIG_UBOOT_USE_PREBUILT=y
# CONFIG_ENABLE_NETWORK_RT_WLAN is not set
CONFIG_MPP_DEFAULT_SENSOR_CSI_2=y
CONFIG_MPP_ENABLE_CSI_DEV_1=y
CONFIG_MPP_CSI_DEV1_RESET=10
CONFIG_MPP_CSI_DEV1_I2C_DEV="i2c4"
CONFIG_MPP_CSI_DEV1_MCLK_1=y
CONFIG_MPP_ENABLE_CSI_DEV_2=y
CONFIG_MPP_CSI_DEV2_RESET=4
CONFIG_MPP_CSI_DEV2_MCLK_2=y
CONFIG_MPP_ENABLE_SENSOR_GC2093=y
CONFIG_MPP_SENSOR_GC2093_ON_CSI1_USE_CHIP_CLK=y
CONFIG_MPP_SENSOR_GC2093_ON_CSI2_USE_CHIP_CLK=y
CONFIG_MPP_ENABLE_DSI_LCD=y
CONFIG_MPP_DSI_LCD_RESET_PIN=3
CONFIG_MPP_DSI_LCD_BACKLIGHT_PIN=5
CONFIG_MPP_DSI_ENABLE_LCD_ST7701=y
CONFIG_OPENSBI_USE_PREBUILT_FW_JUMP=y
```

## configs/k230d_rtos_labplus_ai_camera_defconfig
```kconfig
CONFIG_BOARD_CONFIG_NAME="k230d_rtos_labplus_ai_camera_defconfig"
CONFIG_BOARD_NAME="RtSmart-K230D_LabPlusAiCamera"
CONFIG_BOARD_GEN_IMAGE_CFG_FILE="genimage-sdcard-rtos.cfg"
CONFIG_RTT_AUTO_EXEC_CMD="@preload -K /sdcard/app/examples/integrated_poc/smart_ipc/face_detection_320.kmodel -C 1"
CONFIG_FAST_BOOT_FILE_PATH="${SDK_BUILD_IMAGES_DIR}/sdcard/app/examples/integrated_poc/smart_ipc/smart_ipc.elf"
CONFIG_RTSMART_ENABLE_BUILD_EXAMPLES=y
CONFIG_RTSMART_ENABLE_BUILD_INTEGRATED_EXAMPLES=y
CONFIG_BOARD_K230D_CANMV_LABPLUS_AI_CAMERA=y
CONFIG_UBOOT_USE_PREBUILT=y
# CONFIG_ENABLE_NETWORK_RT_LAN_OVER_USB is not set
# CONFIG_ENABLE_NETWORK_RT_WLAN is not set
CONFIG_MPP_DEFAULT_SENSOR_CSI_2=y
CONFIG_MPP_ENABLE_CSI_DEV_2=y
CONFIG_MPP_CSI_DEV2_RESET=62
CONFIG_MPP_CSI_DEV2_I2C_DEV="i2c0"
CONFIG_MPP_CSI_DEV2_MCLK_1=y
CONFIG_MPP_ENABLE_SENSOR_GC2093=y
CONFIG_MPP_SENSOR_GC2093_ON_CSI2_USE_CHIP_CLK=y
CONFIG_MPP_ENABLE_SENSOR_OV5647=y
CONFIG_MPP_SENSOR_OV5647_ON_CSI2_USE_CHIP_CLK=y
CONFIG_MPP_ENABLE_SENSOR_BF3238=y
CONFIG_MPP_ENABLE_SENSOR_BF3238_ON_CSI2_USE_CHIP_CLK=y
CONFIG_MPP_ENABLE_DSI_LCD=y
CONFIG_MPP_DSI_LCD_RESET_PIN=37
CONFIG_MPP_DSI_LCD_BACKLIGHT_PIN=36
CONFIG_MPP_DSI_ENABLE_LCD_ST7701=y
CONFIG_OPENSBI_USE_PREBUILT_FW_JUMP=y
# CONFIG_ENABLE_MODULE_CV_LITE is not set
```

## configs/k230d_y35_defconfig
```kconfig
CONFIG_BOARD_CONFIG_NAME="k230d_y35_defconfig"
CONFIG_BOARD_K230D_Y35=y
CONFIG_RTT_CONSOLE_UART1=y
# CONFIG_ENABLE_NETWORK_RT_LAN_OVER_USB is not set
CONFIG_MPP_DEFAULT_SENSOR_CSI_2=y
CONFIG_MPP_ENABLE_CSI_DEV_0=y
CONFIG_MPP_CSI_DEV0_RESET=12
CONFIG_MPP_CSI_DEV0_MCLK_1=y
CONFIG_MPP_ENABLE_CSI_DEV_1=y
CONFIG_MPP_CSI_DEV1_RESET=10
CONFIG_MPP_CSI_DEV1_MCLK_2=y
CONFIG_MPP_ENABLE_CSI_DEV_2=y
CONFIG_MPP_CSI_DEV2_RESET=11
CONFIG_MPP_CSI_DEV2_I2C_DEV="i2c4"
CONFIG_MPP_CSI_DEV2_MCLK_3=y
CONFIG_MPP_ENABLE_SENSOR_GC2093=y
CONFIG_MPP_SENSOR_GC2093_ON_CSI0_USE_CHIP_CLK=y
CONFIG_MPP_SENSOR_GC2093_ON_CSI1_USE_CHIP_CLK=y
CONFIG_MPP_SENSOR_GC2093_ON_CSI2_USE_CHIP_CLK=y
CONFIG_MPP_ENABLE_SENSOR_OV5647=y
CONFIG_OPENSBI_USE_PREBUILT_FW_JUMP=y
CONFIG_SDK_ENABLE_CANMV=y
# CONFIG_ENABLE_MODULE_CV_LITE is not set
```
