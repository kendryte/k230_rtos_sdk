## Kconfig.secureboot
```kconfig
menu "Secure Boot Configuration"

    config SECURE_BOOT_CONFIG_FILE
        string "Shared SecureBoot Config Path In Board Dir"
        default "secureboot/secure_config_aes_rsa_pem.json"
        depends on SECURE_BOOT_SPL_ENABLE || SECURE_BOOT_FIRMWARE_ENABLE
        help
            Shared secure-boot config used by SPL and Firmware.
            The configured path is resolved relative to
            boards/${CONFIG_BOARD} by default. An absolute path is also
            accepted.
            Place the secure config and related assets, such as PEM
            certificates and private keys, under a board subdirectory like
            boards/${CONFIG_BOARD}/secureboot/ and set this option to the
            config path within that directory.
            The file should define separate top-level `spl`, and
            `firmware` objects, each containing the stage-specific firmware,
            encryption, and signing settings. Each section should match the
            corresponding `SECURE_BOOT_*_TYPE` selection. Legacy flat
            single-stage files are still accepted by the tooling.

    menuconfig SECURE_BOOT_SPL_ENABLE
        bool "SPL Enable SecureBoot"
        default n
        help
            Protect the SPL image consumed directly by BROM.

        if SECURE_BOOT_SPL_ENABLE
            choice
                prompt "SPL SecureBoot Type"
                default SECURE_BOOT_SPL_NONE

                config SECURE_BOOT_SPL_NONE
                    bool "None"
                config SECURE_BOOT_SPL_SM4_SM2
                    bool "SM4 Encrypt + SM2 Sign"
                config SECURE_BOOT_SPL_AES_RSA
                    bool "AES Encrypt + RSA Sign"
            endchoice

            config SECURE_BOOT_SPL_TYPE
                int
                default 0 if SECURE_BOOT_SPL_NONE
                default 1 if SECURE_BOOT_SPL_SM4_SM2
                default 2 if SECURE_BOOT_SPL_AES_RSA
        endif

    menuconfig SECURE_BOOT_FIRMWARE_ENABLE
        bool "Firmware Enable SecureBoot"
        default n
        help
            Protect firmware using the shared secure-boot config file's `firmware`
            section.

        if SECURE_BOOT_FIRMWARE_ENABLE
            choice
                prompt "Firmware SecureBoot Type"
                default SECURE_BOOT_FIRMWARE_NONE

                config SECURE_BOOT_FIRMWARE_NONE
                    bool "None"
                config SECURE_BOOT_FIRMWARE_SM4_SM2
                    bool "SM4 Encrypt + SM2 Sign"
                config SECURE_BOOT_FIRMWARE_AES_RSA
                    bool "AES Encrypt + RSA Sign"
            endchoice

            config SECURE_BOOT_FIRMWARE_TYPE
                int
                default 0 if SECURE_BOOT_FIRMWARE_NONE
                default 1 if SECURE_BOOT_FIRMWARE_SM4_SM2
                default 2 if SECURE_BOOT_FIRMWARE_AES_RSA
        endif

endmenu
```

## boards/Kconfig
```kconfig
menu "Board Configuration"
    config BOARD_CHIP_K230
        bool
        default n

    config BOARD_CHIP_K230D
        bool 
        default n

    choice BOARD
        bool "Board Type"
        default BOARD_K230_CANMV

        config BOARD_K230_CANMV
            bool "K230 CanMV, Onboard 512M"
            select BOARD_CHIP_K230

        config BOARD_K230_CANMV_V3P0
            bool "K230 CanMV V3.0, Onboard 1GiB LPDDR4"
            select BOARD_CHIP_K230

        config BOARD_K230_CANMV_LCKFB
            bool "K230 CanMV LCKFB, Onboard 1GiB LPDDR4"
            select BOARD_CHIP_K230

        config BOARD_K230_CANMV_YAHBOOM
            bool "K230 CanMV YAHBOOM, Onboard 1GiB LPDDR4"
            select BOARD_CHIP_K230

        config BOARD_K230_CANMV_01STUDIO
            bool "K230 CanMV 01 Studio, Onboard 1GiB LPDDR4"
            select BOARD_CHIP_K230

        config BOARD_K230_CANMV_GT6700
            bool "K230 CanMV GT6700, Onboard 1GiB LPDDR4"
            select BOARD_CHIP_K230

        config BOARD_K230D_CANMV_BPI_ZERO
            bool "K230D CanMV BPI-Zero, SiP 128MiB LPDDR4"
            select BOARD_CHIP_K230D

        config BOARD_K230D_CANMV_JUNROC_AI_CAM
            bool "K230D CanMV JUNROC_AI_CAM, SiP 128MiB LPDDR4"
            select BOARD_CHIP_K230D

        config BOARD_K230_CANMV_DONGSHANPI
            bool "K230 CanMV dongshanpi, Onboard 512MiB/1GiB LPDDR3"
            select BOARD_CHIP_K230

        config BOARD_K230_CANMV_RTT_EVB
            bool "K230 CanMV rtt evb, Onboard 512MiB/1GiB LPDDR3"
            select BOARD_CHIP_K230

        config BOARD_K230_AIHARDWARE
            bool "K230 AiHardWare, Onboard 512M LPDDR4"
            select BOARD_CHIP_K230

        config BOARD_K230D_CANMV_ATK_DNK230D
            bool "K230D CanMV ATK-DNK230D, SiP 128MiB LPDDR4"
            select BOARD_CHIP_K230D

        config BOARD_K230_EVB
            bool "K230 EVB"
            select BOARD_CHIP_K230

        config BOARD_K230D_EVB
            bool "K230D EVB"
            select BOARD_CHIP_K230D

        config BOARD_K230D_CANMV_LABPLUS_AI_CAMERA
            bool "K230D CanMV LabPlus Ai Camera"
            select BOARD_CHIP_K230D

        config BOARD_K230_LABPLUS_1956
            bool "K230 CanMV LabPlus 1956"
            select BOARD_CHIP_K230

    endchoice

    config BOARD
        string
        default "k230_canmv" if BOARD_K230_CANMV
        default "k230_canmv_v3p0" if BOARD_K230_CANMV_V3P0
        default "k230_canmv_lckfb" if BOARD_K230_CANMV_LCKFB
        default "k230_canmv_yahboom" if BOARD_K230_CANMV_YAHBOOM
        default "k230_canmv_01studio" if BOARD_K230_CANMV_01STUDIO
        default "k230_canmv_gt6700" if BOARD_K230_CANMV_GT6700
        default "k230d_canmv_bpi_zero" if BOARD_K230D_CANMV_BPI_ZERO
        default "k230d_canmv_junroc_ai_cam" if BOARD_K230D_CANMV_JUNROC_AI_CAM
	    default "k230_canmv_dongshanpi" if BOARD_K230_CANMV_DONGSHANPI
        default "k230_canmv_rtt_evb" if BOARD_K230_CANMV_RTT_EVB
	    default "k230_aihardware" if BOARD_K230_AIHARDWARE
        default "k230d_canmv_atk_dnk230d" if BOARD_K230D_CANMV_ATK_DNK230D
        default "k230_evb" if BOARD_K230_EVB
        default "k230d_evb" if BOARD_K230D_EVB
        default "k230d_labplus_ai_camera" if BOARD_K230D_CANMV_LABPLUS_AI_CAMERA
        default "k230_labplus_1956" if BOARD_K230_LABPLUS_1956

    config BOARD_NAME
        string "Board Generate Image Name"
        default "CanMV_K230_V1P0_P1" if BOARD_K230_CANMV
        default "CanMV_K230_V3P0" if BOARD_K230_CANMV_V3P0
        default "CanMV_K230_LCKFB" if BOARD_K230_CANMV_LCKFB
        default "CanMV_K230_YAHBOOM" if BOARD_K230_CANMV_YAHBOOM
        default "CanMV_K230_01Studio" if BOARD_K230_CANMV_01STUDIO
        default "CanMV_K230_GT6700" if BOARD_K230_CANMV_GT6700
        default "CanMV_K230_RTT_EVB_BOARD" if BOARD_K230_CANMV_RTT_EVB
        default "CanMV_K230D_Zero" if BOARD_K230D_CANMV_BPI_ZERO
        default "CanMV_K230D_JUNROC_AI_CAM" if BOARD_K230D_CANMV_JUNROC_AI_CAM
        default "K230_aihardware" if BOARD_K230_AIHARDWARE
        default "CanMV_K230D_ATK_DNK230D" if BOARD_K230D_CANMV_ATK_DNK230D
        default "K230_EVB" if BOARD_K230_EVB
        default "K230D_EVB" if BOARD_K230D_EVB
        default "CanMV_K230D_LabPlusAiCamera" if BOARD_K230D_CANMV_LABPLUS_AI_CAMERA
        default "CanMV_K230_LabPlus_1956" if BOARD_K230_LABPLUS_1956

    config BOARD_GEN_IMAGE_CFG_FILE
        string "Board specified generate image configure file"
        default "genimage-sdcard.cfg"

    menu "Memory Layout"
        config AUTO_DETECT_DDR_SIZE
            bool "Auto Detect DRAM Size"
                default y  if BOARD_K230_CANMV_01STUDIO ||  BOARD_K230_CANMV_DONGSHANPI
                default n

        source "$(SDK_BOARDS_DIR)/Kconfig.memory_auto"
        source "$(SDK_BOARDS_DIR)/Kconfig.memory_static"
    endmenu

    config MEM_BASE_ADDR
        hex
        default MEM_RTSMART_BASE

    config MEM_RTSMART_BASE
        hex
        default 0x0000000
        help
            Should same as uboot dts memory node

    config RTSMART_OPENSIB_MEMORY_SIZE
        hex
        default 0x20000

    source "$(SDK_BOARDS_DIR)/k230_canmv/Kconfig"
    source "$(SDK_BOARDS_DIR)/k230_canmv_v3p0/Kconfig"
    source "$(SDK_BOARDS_DIR)/k230_canmv_lckfb/Kconfig"
    source "$(SDK_BOARDS_DIR)/k230_canmv_01studio/Kconfig"
    source "$(SDK_BOARDS_DIR)/k230_canmv_gt6700/Kconfig"
    source "$(SDK_BOARDS_DIR)/k230d_canmv_bpi_zero/Kconfig"
    source "$(SDK_BOARDS_DIR)/k230d_canmv_junroc_ai_cam/Kconfig"
    source "$(SDK_BOARDS_DIR)/k230_canmv_dongshanpi/Kconfig"
    source "$(SDK_BOARDS_DIR)/k230_canmv_rtt_evb/Kconfig"
    source "$(SDK_BOARDS_DIR)/k230_aihardware/Kconfig"
    source "$(SDK_BOARDS_DIR)/k230d_canmv_atk_dnk230d/Kconfig"
    source "$(SDK_BOARDS_DIR)/k230_evb/Kconfig"
    source "$(SDK_BOARDS_DIR)/k230d_labplus_ai_camera/Kconfig"
    source "$(SDK_BOARDS_DIR)/k230_labplus_1956/Kconfig"

endmenu
```

## boards/Kconfig.memory_static
```kconfig
if !AUTO_DETECT_DDR_SIZE
    config MEM_TOTAL_SIZE
        hex "DDR Memory Size"
        default 0x20000000 if BOARD_K230_CANMV
        default 0x40000000 if BOARD_K230_CANMV_V3P0
        default 0x40000000 if BOARD_K230_CANMV_LCKFB
        default 0x40000000 if BOARD_K230_CANMV_01STUDIO
        default 0x20000000 if BOARD_K230_CANMV_DONGSHANPI
        default 0x20000000 if BOARD_K230_CANMV_RTT_EVB
        default 0x20000000 if BOARD_K230_AIHARDWARE
        default 0x20000000 if BOARD_K230_EVB
        default 0x8000000
        help
            Should same as uboot dts memory node

    comment "Memory Layout"

    config MEM_RTSMART_SIZE
        hex "RT-Smart Memory Total Size"
        default 0x10000000 if BOARD_K230_CANMV
        default 0x20000000 if BOARD_K230_CANMV_V3P0
        default 0x20000000 if BOARD_K230_CANMV_LCKFB
        default 0x20000000 if BOARD_K230_CANMV_01STUDIO
        default 0x10000000 if BOARD_K230_CANMV_RTT_EVB
        default 0x10000000 if BOARD_K230_CANMV_DONGSHANPI
        default 0x10000000 if BOARD_K230_AIHARDWARE
        default 0x10000000 if BOARD_K230_EVB
        default 0x3A00000

    config MEM_RTSMART_HEAP_SIZE
        hex "RT-Smart Memory Heap Size"
        default 0x2000000 if BOARD_K230_CANMV
        default 0x4000000 if BOARD_K230_CANMV_V3P0
        default 0x4000000 if BOARD_K230_CANMV_LCKFB
        default 0x4000000 if BOARD_K230_CANMV_01STUDIO
        default 0x2000000 if BOARD_K230_CANMV_RTT_EVB
        default 0x2000000 if BOARD_K230_CANMV_DONGSHANPI
        default 0x2000000 if BOARD_K230_AIHARDWARE
        default 0x2000000 if BOARD_K230_EVB
        default 0x800000

    config MEM_MMZ_BASE
        hex "Memory address of MMZ"
        default 0x10000000 if BOARD_K230_CANMV
        default 0x20000000 if BOARD_K230_CANMV_V3P0
        default 0x20000000 if BOARD_K230_CANMV_LCKFB
        default 0x20000000 if BOARD_K230_CANMV_01STUDIO
        default 0x10000000 if BOARD_K230_CANMV_RTT_EVB
        default 0x10000000 if BOARD_K230_CANMV_DONGSHANPI
        default 0x10000000 if BOARD_K230_AIHARDWARE
        default 0x10000000 if BOARD_K230_EVB
        default 0x3A00000

    config MEM_MMZ_SIZE
        hex "Memory size for mmz"
        default 0x10000000 if BOARD_K230_CANMV
        default 0x20000000 if BOARD_K230_CANMV_V3P0
        default 0x20000000 if BOARD_K230_CANMV_LCKFB
        default 0x20000000 if BOARD_K230_CANMV_01STUDIO
        default 0x10000000 if BOARD_K230_CANMV_RTT_EVB
        default 0x10000000 if BOARD_K230_CANMV_DONGSHANPI
        default 0x10000000 if BOARD_K230_AIHARDWARE
        default 0x10000000 if BOARD_K230_EVB
        default 0x4600000
endif
```

## boards/k230_canmv_gt6700/Kconfig
```kconfig
if BOARD_K230_CANMV_GT6700
    config BOARD_NOT_SUPPORT_HW_RTC
        def_bool y
endif
```

## boards/k230_canmv_hiwonder/Kconfig
```kconfig
if BOARD_K230_CANMV_HIWONDER
    config BOARD_NOT_SUPPORT_HW_RTC
        def_bool y
endif
```

## boards/k230_canmv_mrt/Kconfig
```kconfig
if BOARD_K230_CANMV_MRT
    config BOARD_NOT_SUPPORT_HW_RTC
        def_bool y
endif
```

## boards/k230_canmv_wondermk/Kconfig
```kconfig
if BOARD_K230_CANMV_WONDERMK
    config BOARD_NOT_SUPPORT_HW_RTC
        def_bool y
endif
```

## boards/k230_canmv_yahboom/Kconfig
```kconfig
if BOARD_K230_CANMV_YAHBOOM
    config BOARD_NOT_SUPPORT_HW_RTC
        def_bool y
endif
```

## boards/k230d_canmv_junroc_ai_cam/Kconfig
```kconfig
if BOARD_K230D_CANMV_JUNROC_AI_CAM
    config BOARD_NOT_SUPPORT_HW_RTC
        def_bool y
endif
```

## configs/k230_canmv_lckfb_fast_defconfig
```kconfig
CONFIG_BOARD_CONFIG_NAME="k230_canmv_lckfb_fast_defconfig"
CONFIG_BOARD_K230_CANMV_LCKFB=y
CONFIG_BOARD_NAME="CanMV_K230_LCKFB_Fast"
CONFIG_UBOOT_CONFIG_FILE="k230_canmv_lckfb_fast"
CONFIG_UBOOT_ENABLE_FAST_BOOT=y
CONFIG_RTT_CONSOLE_BAUD=1500000
CONFIG_RTT_AUTO_EXEC_CMD="/rom/micropython"
CONFIG_ENABLE_UVC_CAMERA=y
CONFIG_RTSMART_ENABLE_ROMFS=y
CONFIG_MPP_DEFAULT_SENSOR_CSI_2=y
CONFIG_MPP_ENABLE_CSI_DEV_0=y
CONFIG_MPP_CSI_DEV0_RESET=29
CONFIG_MPP_ENABLE_CSI_DEV_1=y
CONFIG_MPP_CSI_DEV1_RESET=31
CONFIG_MPP_ENABLE_CSI_DEV_2=y
CONFIG_MPP_CSI_DEV2_RESET=13
CONFIG_MPP_CSI_DEV2_I2C_DEV="i2c4"
CONFIG_MPP_ENABLE_SENSOR_GC2093=y
CONFIG_MPP_ENABLE_SENSOR_OV5647=y
CONFIG_MPP_ENABLE_DSI_HDMI=y
CONFIG_MPP_DSI_HDMI_RESET_PIN=24
CONFIG_MPP_ENABLE_DSI_LCD=y
CONFIG_MPP_DSI_LCD_RESET_PIN=22
CONFIG_MPP_DSI_ENABLE_HDMI_LT9611=y
CONFIG_MPP_DSI_ENABLE_LCD_ST7701=y
CONFIG_MPP_DSI_ENABLE_LCD_ILI9881=y
CONFIG_OPENSBI_USE_PREBUILT_FW_JUMP=y
CONFIG_SDK_ENABLE_CANMV=y
CONFIG_CANMV_OPENMV_CFG_FB_ALLOC_SIZE=0x1400000
CONFIG_CANMV_OPENMV_CFG_FB_ALLOC_COUNT=640
```

## configs/k230_canmv_mrt_defconfig
```kconfig
CONFIG_BOARD_CONFIG_NAME="k230_canmv_mrt_defconfig"
CONFIG_BOARD_K230_CANMV_MRT=y
CONFIG_AUTO_DETECT_DDR_SIZE=y
# CONFIG_AUTO_DDR_SIZE_512 is not set
# CONFIG_AUTO_DDR_SIZE_2048 is not set
CONFIG_UBOOT_USE_PREBUILT=y
CONFIG_ENABLE_DUAL_CDC_PORT=y
# CONFIG_ENABLE_NETWORK_RT_LAN_OVER_USB is not set
CONFIG_MPP_ENABLE_CSI_DEV_0=y
CONFIG_MPP_CSI_DEV0_POWER=11
CONFIG_MPP_CSI_DEV0_RESET=9
CONFIG_MPP_CSI_DEV0_I2C_DEV="i2c4"
CONFIG_MPP_CSI_DEV0_MCLK_1=y
CONFIG_MPP_ENABLE_SENSOR_GC2093=y
CONFIG_MPP_SENSOR_GC2093_ON_CSI0_USE_CHIP_CLK=y
CONFIG_MPP_ENABLE_DSI_LCD=y
CONFIG_MPP_DSI_LCD_RESET_PIN=43
CONFIG_MPP_DSI_LCD_BACKLIGHT_PIN=42
CONFIG_MPP_DSI_ENABLE_LCD_ST7701=y
CONFIG_OPENSBI_USE_PREBUILT_FW_JUMP=y
CONFIG_SDK_ENABLE_CANMV=y
```

## configs/k230_canmv_rtt_evb_board_defconfig
```kconfig
CONFIG_BOARD_CONFIG_NAME="k230_canmv_rtt_evb_board_defconfig"
CONFIG_BOARD_K230_CANMV_RTT_EVB=y
CONFIG_BOARD_NAME="CanMV-K230_RTT_EVB_BOARD"
CONFIG_RTSMART_CONFIG_FILE="k230_canmv_rtt_evb_defconfig"
CONFIG_MPP_DEFAULT_SENSOR_CSI_2=y
CONFIG_MPP_ENABLE_CSI_DEV_2=y
CONFIG_MPP_CSI_DEV2_RESET=21
CONFIG_MPP_CSI_DEV2_I2C_DEV="i2c4"
CONFIG_MPP_CSI_DEV2_MCLK_1=y
CONFIG_MPP_ENABLE_SENSOR_GC2093=y
CONFIG_MPP_SENSOR_GC2093_ON_CSI2_USE_CHIP_CLK=y
CONFIG_MPP_ENABLE_DSI_LCD=y
CONFIG_MPP_DSI_LCD_RESET_PIN=22
CONFIG_MPP_DSI_ENABLE_LCD_NT35516=y
CONFIG_SDK_ENABLE_CANMV=y
# CONFIG_ENABLE_TOUCH_DRIVER_CST_MUTCAP is not set
# CONFIG_ENABLE_TOUCH_DRIVER_GT911 is not set
```

## configs/k230_canmv_yahboom_defconfig
```kconfig
CONFIG_BOARD_CONFIG_NAME="k230_canmv_yahboom_defconfig"
CONFIG_BOARD_K230_CANMV_YAHBOOM=y
CONFIG_RTT_CONSOLE_BAUD=1000000
CONFIG_ENABLE_UVC_CAMERA=y
CONFIG_MPP_DEFAULT_SENSOR_CSI_2=y
CONFIG_MPP_ENABLE_SENSOR_AF=y
CONFIG_MPP_ENABLE_SENSOR_AF_DRV_DW9714P=y
CONFIG_MPP_ENABLE_CSI_DEV_2=y
CONFIG_MPP_CSI_DEV2_RESET=62
CONFIG_MPP_CSI_DEV2_I2C_DEV="i2c4"
CONFIG_MPP_CSI_DEV2_MCLK_3=y
CONFIG_MPP_ENABLE_SENSOR_GC2093=y
CONFIG_MPP_SENSOR_GC2093_ON_CSI2_USE_CHIP_CLK=y
CONFIG_MPP_ENABLE_DSI_LCD=y
CONFIG_MPP_DSI_LCD_RESET_PIN=22
CONFIG_MPP_DSI_ENABLE_LCD_ST7701=y
CONFIG_OPENSBI_USE_PREBUILT_FW_JUMP=y
CONFIG_SDK_ENABLE_CANMV=y
CONFIG_CANMV_OPENMV_CFG_FB_ALLOC_SIZE=0x1400000
CONFIG_CANMV_OPENMV_CFG_FB_ALLOC_COUNT=640
```
