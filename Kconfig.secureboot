## configs/k230_rtos_evb_defconfig
```kconfig
CONFIG_BOARD_CONFIG_NAME="k230_rtos_evb_defconfig"
CONFIG_BOARD_K230_EVB=y
CONFIG_AUTO_DETECT_DDR_SIZE=y
# CONFIG_AUTO_DDR_SIZE_1024 is not set
# CONFIG_AUTO_DDR_SIZE_2048 is not set
CONFIG_UBOOT_USE_PREBUILT=y
CONFIG_RTT_AUTO_EXEC_CMD="/bin/preload -K /sdcard/app/examples/integrated_poc/face_detection_320.kmodel -C 2"
CONFIG_FAST_BOOT_FILE_PATH="${SDK_BUILD_IMAGES_DIR}/sdcard/app/examples/integrated_poc/smart_ipc.elf""
CONFIG_RTT_ENABLE_BUILD_EXAMPLES=y
CONFIG_RTT_ENABLE_BUILD_INTEGRATED_EXAMPLES=y
CONFIG_MPP_ENABLE_CSI_DEV_0=y
CONFIG_MPP_CSI_DEV0_RESET=46
CONFIG_MPP_ENABLE_SENSOR_IMX335=y
CONFIG_MPP_SENSOR_IMX335_ENABLE_4LANE_CONFIGURE=y
CONFIG_MPP_ENABLE_DSI_LCD=y
CONFIG_MPP_DSI_LCD_RESET_PIN=9
CONFIG_MPP_DSI_LCD_BACKLIGHT_PIN=31
# CONFIG_MPP_DSI_ENABLE_VIRT is not set
CONFIG_MPP_DSI_ENABLE_LCD_HX8399=y
CONFIG_OPENSBI_USE_PREBUILT_FW_JUMP=y
```

## configs/k230_rtos_evb_secureboot_defconfig
```kconfig
CONFIG_BOARD_CONFIG_NAME="k230_rtos_evb_secureboot_defconfig"
CONFIG_BOARD_K230_EVB=y
CONFIG_AUTO_DETECT_DDR_SIZE=y
# CONFIG_AUTO_DDR_SIZE_1024 is not set
# CONFIG_AUTO_DDR_SIZE_2048 is not set
CONFIG_RTT_AUTO_EXEC_CMD="@preload"
CONFIG_MPP_ENABLE_CSI_DEV_0=y
CONFIG_MPP_CSI_DEV0_RESET=46
CONFIG_MPP_ENABLE_SENSOR_IMX335=y
CONFIG_MPP_SENSOR_IMX335_ENABLE_4LANE_CONFIGURE=y
# CONFIG_MPP_DSI_ENABLE_VIRT is not set
CONFIG_MPP_ENABLE_DSI_LCD=y
CONFIG_MPP_DSI_LCD_RESET_PIN=9
CONFIG_MPP_DSI_LCD_BACKLIGHT_PIN=31
CONFIG_MPP_DSI_ENABLE_LCD_HX8399=y
CONFIG_OPENSBI_USE_PREBUILT_FW_JUMP=y
CONFIG_APP_ENABLE_HELLOWORLD=y
CONFIG_FAST_BOOT_FILE_PATH="${SDK_BUILD_IMAGES_DIR}/sdcard/app/helloworld"
CONFIG_SECURE_BOOT_CONFIG_FILE="secureboot/secure_config_sm4_sm2.json"
CONFIG_SECURE_BOOT_SPL_ENABLE=y
CONFIG_SECURE_BOOT_SPL_SM4_SM2=y
CONFIG_SECURE_BOOT_FIRMWARE_ENABLE=y
CONFIG_SECURE_BOOT_FIRMWARE_SM4_SM2=y
```

## configs/k230d_canmv_evb_defconfig
```kconfig
CONFIG_BOARD_CONFIG_NAME="k230d_canmv_evb_defconfig"
CONFIG_BOARD_K230D_EVB=y
CONFIG_MEM_RTSMART_HEAP_SIZE=0x1000000
CONFIG_RTSMART_CONFIG_FILE="k230d_evb_canmv"
# CONFIG_ENABLE_NETWORK_RT_LAN_OVER_USB is not set
# CONFIG_ENABLE_NETWORK_RT_WLAN is not set
CONFIG_MPP_ENABLE_CSI_DEV_0=y
CONFIG_MPP_CSI_DEV0_RESET=37
CONFIG_MPP_ENABLE_SENSOR_IMX335=y
CONFIG_MPP_SENSOR_IMX335_ENABLE_4LANE_CONFIGURE=y
CONFIG_MPP_ENABLE_DSI_LCD=y
CONFIG_MPP_DSI_LCD_RESET_PIN=21
CONFIG_MPP_DSI_LCD_BACKLIGHT_PIN=20
# CONFIG_MPP_DSI_ENABLE_VIRT is not set
CONFIG_MPP_DSI_ENABLE_LCD_HX8399=y
CONFIG_OPENSBI_USE_PREBUILT_FW_JUMP=y
CONFIG_SDK_ENABLE_CANMV=y
# CONFIG_ENABLE_MODULE_CV_LITE is not set
CONFIG_CANMV_OPENMV_CFG_FB_ALLOC_SIZE=0x500000
```

## configs/k230d_canmv_junroc_ai_cam_defconfig
```kconfig
CONFIG_BOARD_CONFIG_NAME="k230d_canmv_junroc_ai_cam_defconfig"
CONFIG_BOARD_K230D_CANMV_JUNROC_AI_CAM=y
# CONFIG_ENABLE_NETWORK_RT_LAN_OVER_USB is not set
CONFIG_MPP_DEFAULT_SENSOR_CSI_1=y
CONFIG_MPP_ENABLE_CSI_DEV_1=y
CONFIG_MPP_CSI_DEV1_RESET=10
CONFIG_MPP_CSI_DEV1_I2C_DEV="i2c4"
CONFIG_MPP_CSI_DEV1_MCLK_1=y
CONFIG_MPP_ENABLE_SENSOR_GC2093=y
CONFIG_MPP_SENSOR_GC2093_ON_CSI1_USE_CHIP_CLK=y
CONFIG_MPP_ENABLE_SENSOR_OV5647=y
CONFIG_MPP_ENABLE_DSI_LCD=y
CONFIG_MPP_DSI_ENABLE_LCD_HX8399=y
CONFIG_MPP_DSI_ENABLE_LCD_ST7701=y
CONFIG_SDK_ENABLE_CANMV=y
```

## configs/k230d_canmv_mini_defconfig
```kconfig
CONFIG_BOARD_CONFIG_NAME="k230d_canmv_mini_defconfig"
CONFIG_BOARD_K230D_CANMV_MINI=y
# CONFIG_ENABLE_NETWORK_RT_LAN_OVER_USB is not set
CONFIG_MPP_DEFAULT_SENSOR_CSI_1=y
CONFIG_MPP_ENABLE_CSI_DEV_1=y
CONFIG_MPP_CSI_DEV1_RESET=13
CONFIG_MPP_CSI_DEV1_I2C_DEV="i2c4"
CONFIG_MPP_ENABLE_SENSOR_GC2093=y
CONFIG_MPP_ENABLE_SENSOR_OV5647=y
CONFIG_MPP_ENABLE_DSI_LCD=y
CONFIG_MPP_DSI_LCD_BACKLIGHT_PIN=23
CONFIG_MPP_DSI_ENABLE_LCD_ST7701=y
CONFIG_SDK_ENABLE_CANMV=y
```
