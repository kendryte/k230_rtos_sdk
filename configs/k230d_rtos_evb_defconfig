## configs/k230d_rtos_evb_defconfig
```kconfig
CONFIG_BOARD_CONFIG_NAME="k230d_rtos_evb_defconfig"
CONFIG_BOARD_K230_EVB=y
CONFIG_BOARD_NAME="K230D_EVB"
CONFIG_MEM_TOTAL_SIZE=0x8000000
CONFIG_MEM_RTSMART_SIZE=0x4E00000
CONFIG_MEM_RTSMART_HEAP_SIZE=0xA00000
CONFIG_MEM_MMZ_BASE=0x4E00000
CONFIG_MEM_MMZ_SIZE=0x3200000
CONFIG_UBOOT_CONFIG_FILE="k230d_evb"
CONFIG_RTSMART_CONFIG_FILE="k230d_evb"
CONFIG_RTT_AUTO_EXEC_CMD="/sdcard/app/examples/integrated_poc/smart_ipc.elf -K /sdcard/app/examples/integrated_poc/face_detection_320.kmodel -C 2"
CONFIG_MPP_ENABLE_CSI_DEV_0=y
CONFIG_MPP_CSI_DEV0_RESET=37
CONFIG_MPP_ENABLE_SENSOR_IMX335=y
CONFIG_MPP_SENSOR_IMX335_ENABLE_4LANE_CONFIGURE=y
CONFIG_MPP_ENABLE_DSI_LCD=y
CONFIG_MPP_DSI_LCD_RESET_PIN=21
CONFIG_MPP_DSI_LCD_BACKLIGHT_PIN=20
# CONFIG_MPP_DSI_ENABLE_VIRT is not set
CONFIG_MPP_DSI_ENABLE_LCD_HX8399=y
CONFIG_MPP_ENABLE_USERAPPS_SAMPLES=y
# CONFIG_MPP_ENABLE_USER_SAMPLES_FASTBOOT_APP is not set
# CONFIG_MPP_ENABLE_USER_SAMPLES_SAMPLE_ADC is not set
# CONFIG_MPP_ENABLE_USER_SAMPLES_SAMPLE_AUDIO is not set
# CONFIG_MPP_ENABLE_USER_SAMPLES_SAMPLE_AV is not set
# CONFIG_MPP_ENABLE_USER_SAMPLES_SAMPLE_CANAN_UART_RX is not set
# CONFIG_MPP_ENABLE_USER_SAMPLES_SAMPLE_CANAN_UART_TX is not set
# CONFIG_MPP_ENABLE_USER_SAMPLES_SAMPLE_CIPHER is not set
# CONFIG_MPP_ENABLE_USER_SAMPLES_SAMPLE_CSC is not set
# CONFIG_MPP_ENABLE_USER_SAMPLES_SAMPLE_DMA is not set
# CONFIG_MPP_ENABLE_USER_SAMPLES_SAMPLE_DMA_BIND is not set
# CONFIG_MPP_ENABLE_USER_SAMPLES_SAMPLE_DPU is not set
# CONFIG_MPP_ENABLE_USER_SAMPLES_SAMPLE_DPU_VICAP is not set
# CONFIG_MPP_ENABLE_USER_SAMPLES_SAMPLE_DPU_VO is not set
# CONFIG_MPP_ENABLE_USER_SAMPLES_SAMPLE_DW200 is not set
# CONFIG_MPP_ENABLE_USER_SAMPLES_SAMPLE_EEPROM is not set
# CONFIG_MPP_ENABLE_USER_SAMPLES_SAMPLE_FACE_AE is not set
# CONFIG_MPP_ENABLE_USER_SAMPLES_SAMPLE_FACE_DETECT is not set
# CONFIG_MPP_ENABLE_USER_SAMPLES_SAMPLE_FFT is not set
# CONFIG_MPP_ENABLE_USER_SAMPLES_SAMPLE_GPIO is not set
# CONFIG_MPP_ENABLE_USER_SAMPLES_SAMPLE_I2C_SLAVE is not set
# CONFIG_MPP_ENABLE_USER_SAMPLES_SAMPLE_LOG is not set
# CONFIG_MPP_ENABLE_USER_SAMPLES_SAMPLE_MMZ is not set
# CONFIG_MPP_ENABLE_USER_SAMPLES_SAMPLE_NONAI_2D is not set
# CONFIG_MPP_ENABLE_USER_SAMPLES_SAMPLE_OTP is not set
# CONFIG_MPP_ENABLE_USER_SAMPLES_SAMPLE_PWM is not set
# CONFIG_MPP_ENABLE_USER_SAMPLES_SAMPLE_SENSOR_OTP is not set
# CONFIG_MPP_ENABLE_USER_SAMPLES_SAMPLE_TRIPLE_CAMERA_FACEDETECT is not set
# CONFIG_MPP_ENABLE_USER_SAMPLES_SAMPLE_TS is not set
# CONFIG_MPP_ENABLE_USER_SAMPLES_SAMPLE_VB is not set
# CONFIG_MPP_ENABLE_USER_SAMPLES_SAMPLE_VDD_R is not set
# CONFIG_MPP_ENABLE_USER_SAMPLES_SAMPLE_VDEC is not set
# CONFIG_MPP_ENABLE_USER_SAMPLES_SAMPLE_VDSS is not set
# CONFIG_MPP_ENABLE_USER_SAMPLES_SAMPLE_VDV is not set
# CONFIG_MPP_ENABLE_USER_SAMPLES_SAMPLE_VENC is not set
# CONFIG_MPP_ENABLE_USER_SAMPLES_SAMPLE_VICAP is not set
# CONFIG_MPP_ENABLE_USER_SAMPLES_SAMPLE_VIRTUAL_VIO is not set
# CONFIG_MPP_ENABLE_USER_SAMPLES_SAMPLE_VO is not set
# CONFIG_MPP_ENABLE_USER_SAMPLES_SAMPLE_WDT is not set
# CONFIG_MPP_ENABLE_USER_SAMPLES_SAMPLE_TIGER is not set
# CONFIG_MPP_ENABLE_USER_SAMPLES_SAMPLE_UVC is not set
# CONFIG_MPP_ENABLE_USER_SAMPLES_SAMPLE_JAMLINK is not set
CONFIG_OPENSBI_USE_PREBUILT_FW_JUMP=y
```

## src/opensbi/Kconfig
```kconfig
menu "Opensbi Configuration"

    config OPENSBI_CONSOLE_UART_REG_ADDR
        hex
        default 0x91400000 if RTT_CONSOLE_UART0
        default 0x91401000 if RTT_CONSOLE_UART1
        default 0x91402000 if RTT_CONSOLE_UART2
        default 0x91403000 if RTT_CONSOLE_UART3
        default 0x91404000 if RTT_CONSOLE_UART4
    
    menuconfig OPENSBI_USE_PREBUILT_FW_JUMP
        bool "OpenSBI Use Prebuilt FW Jump"
        default n

        if OPENSBI_USE_PREBUILT_FW_JUMP
            config OPENSBI_PREBUILT_FW_JUMP_PATH
                string "Prebuilt FW Jump Path (under board folder)"
                default "opensbi_fw_jump.bin"
        endif
endmenu
```

## src/rtsmart/Kconfig
```kconfig
menu "RT-Smart Configuration"

    config RTSMART_CONFIG_FILE
        string "Rtsmart config file prefix"
        default BOARD
        help
            rtsmart board config file name without _defconfig

    choice RTT_CONSOLE_ID
        bool "Rtsmart console uart"
        default RTT_CONSOLE_UART0

        config RTT_CONSOLE_UART0
            bool "UART0"
        config RTT_CONSOLE_UART1
            bool "UART1"
        config RTT_CONSOLE_UART2
            bool "UART2"
        config RTT_CONSOLE_UART3
            bool "UART3"
        config RTT_CONSOLE_UART4
            bool "UART4"
    endchoice

    config RTT_CONSOLE_ID
        int
        default 0 if RTT_CONSOLE_UART0
        default 1 if RTT_CONSOLE_UART1
        default 2 if RTT_CONSOLE_UART2
        default 3 if RTT_CONSOLE_UART3
        default 4 if RTT_CONSOLE_UART4

    config RTT_CONSOLE_BAUD
        int "Rtsmart console uart baudrate"
        default 115200

    config RTSMART_LWP_APP_STACK_SIZE
        hex "Rtsmart LWP app stack size"
        default 0x20000
        help
            The stack size for LWP application, default is 0x20000 bytes.

    config RTT_AUTO_EXEC_CMD
        string "Rtsmart auto execute command string"
        default "/bin/preload &"

    menuconfig RT_AUTO_RESIZE_PARTITION
        bool "Enable auto resize partition"
        default y
        help
            Support auto resize the last partition, use the disk remain space
            Now just support MMC device and MBR partition table.

        if RT_AUTO_RESIZE_PARTITION
            config RT_PARTITION_NUMBER
                int "RTSmart Filesystem Count"
                default 3
                range 2 3
        endif

    menu "RT-Thread Smart System Features"
        config ENABLE_NETWORK_RT_LAN_OVER_USB
            bool "Enable Network RT-Thread Lan(eth) over USB"
            default y

        config ENABLE_NETWORK_RT_WLAN
            bool "Enable Network RT-Thread Wlan"
            default y

        menuconfig ENABLE_UVC_CAMERA
            bool "Enable UVC Camera Support"
            default n

            if ENABLE_UVC_CAMERA
                config USBHOST_MAX_VIDEO_CLASS
                    int "Max Support uvc device"
                    default 1
            endif

        config ENABLE_ROTARY_ENCODER
            bool "Enable Rotary Encoder Support"
            default n
    endmenu

    comment "Examples Configuration"
    source "$(SDK_BUILD_DIR)/Kconfig.rtt_examples"

endmenu
```

## src/uboot/Kconfig
```kconfig
menu "Uboot Configuration"

    config UBOOT_CONFIG_FILE
        string "Uboot config file prefix"
        default BOARD
        help
            uboot board config file name without _defconfig

    config UBOOT_ENV_FILE
        string "Uboot enviroment file"
        default "default.env"

    menuconfig UBOOT_USE_PREBUILT
        bool "Uboot Use Prebuilt Binaries"
        default n

        if UBOOT_USE_PREBUILT
            config UBOOT_PREBUILT_SPL_PATH
                string "Prebuilt u-boot-spl.bin Path (under board folder)"
                default "u-boot-spl.bin"

            config UBOOT_PREBUILT_UBOOT_PATH
                string "Prebuilt u-boot.bin Path (under board folder)"
                default "u-boot.bin"

            config SYS_TEXT_BASE
                hex "Uboot Text Base Addr"
                default 0x1000000
        endif

endmenu
```
